## layers/meta-magnesium/conf/machine/milkv-duo-256.conf
```bitbake
#@TYPE: Machine
#@NAME: Milk-V Duo 256M (SG2002)
require conf/machine/include/cv18xx-magnesium.inc
```

## layers/meta-magnesium/conf/machine/milkv-duo.conf
```bitbake
#@TYPE: Machine
#@NAME: Milk-V Duo (64 MB, CV1800B)
require conf/machine/include/cv18xx-magnesium.inc
CVITEK_DRAM_SIZE = "0x04000000"
CVITEK_RTOS_SIZE = "0x000c0000"
CVITEK_SOC_FAMILY = "cv180x"
```

## layers/meta-magnesium/recipes-kernel/linux/linux-cvitek/multi.its
```
/dts-v1/;
/ {
	description = "Magnesium CV18xx Linux (no initramfs)";
	#address-cells = <1>;
	images {
		kernel {
			description = "Linux";
			data = /incbin/("Image.gz");
			type = "kernel";
			arch = "riscv";
			os = "linux";
			compression = "gzip";
			load = <0x80200000>;
			entry = <0x80200000>;
			hash-1 { algo = "sha256"; };
		};
		fdt {
			description = "Magnesium headless board DTB";
			data = /incbin/("board.dtb");
			type = "flat_dt";
			arch = "riscv";
			compression = "none";
			hash-1 { algo = "sha256"; };
		};
	};
	configurations {
		default = "config-1";
		config-1 {
			kernel = "kernel";
			fdt = "fdt";
		};
	};
};
```
