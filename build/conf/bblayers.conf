## build/conf/bblayers.conf
```bitbake
# POKY_BBLAYERS_CONF_VERSION is increased each time build/conf/bblayers.conf
# changes incompatibly
POKY_BBLAYERS_CONF_VERSION = "2"

BBPATH = "${TOPDIR}"
BBFILES ?= ""

BBLAYERS ?= " \
  ${TOPDIR}/../layers/openembedded-core/meta \
  \
  ${TOPDIR}/../layers/meta-yocto/meta-poky \
  ${TOPDIR}/../layers/meta-yocto/meta-yocto-bsp \
  \
  ${TOPDIR}/../layers/meta-openembedded/meta-oe \
  ${TOPDIR}/../layers/meta-openembedded/meta-python \
  \
  ${TOPDIR}/../layers/meta-magnesium \
  ${TOPDIR}/../layers/meta-rockchip \
  "
```

## build/conf/local.conf
```bitbake
#===============================================================================
# Basic Configuration
#===============================================================================

# Supported images

#MACHINE  = "luckfox-lyra-plus"
#MACHINE = "luckfox-lyra-ultra"
#MACHINE = "luckfox-lyra-pi-b-w"
MACHINE  = "luckfox-lyra-pi"

CONF_VERSION = "2"

DISTRO  = "magnesium"

# Uncomment if you want deterministic downloads/sstate outside the build dir
# DL_DIR        = "${TOPDIR}/downloads"
# SSTATE_DIR    = "${TOPDIR}/sstate-cache"

#===============================================================================
# Performance / Disk Space Optimizations
#===============================================================================

# Remove work directories (keeps only image artifacts)
INHERIT += "rm_work"

# Don't generate debug symbol packages
PACKAGE_DEBUG_SPLIT_STYLE = "none"
INHIBIT_PACKAGE_DEBUG_SPLIT = "1"
INHIBIT_PACKAGE_STRIP = "0"

# Disable build history
INHERIT:remove = "buildhistory"

# OPTIONAL: Lower SSD usage drastically (but slower builds)
# INHERIT += "icecc"
# BB_NUMBER_THREADS ?= "4"
# PARALLEL_MAKE ?= "-j4"

#===============================================================================
# Distro / License
#===============================================================================

ACCEPT_FSL_EULA = "1"
LICENSE_FLAGS_ACCEPTED += "commercial"

#===============================================================================
# Miscellaneous
#===============================================================================

# Empty the REPRODUCIBLE_TIMESTAMP_ROOTFS variable, otherwise
# the /etc/version becames a fixed value of "20180309123456" (instead of the BUILDNAME).
# This seems to be a bug in the newer yocto versions.
REPRODUCIBLE_TIMESTAMP_ROOTFS = ""
```

## layers/meta-magnesium/conf/distro/magnesium.conf
```bitbake
# Base on poky defaults
require conf/distro/poky.conf

DISTRO = "magnesium"
DISTRO_NAME = "Magnesium Embedded Linux"
DISTRO_VERSION = "1.0"
DISTRO_CODENAME = "magnesium"

require ../../version-magnesium.inc

# Development-friendly features
DISTRO_FEATURES:append = " ipv4 largefile"

# Init system – keep simple for bring-up
INIT_MANAGER = "sysvinit"

VIRTUAL-RUNTIME_init_manager = "busybox"
VIRTUAL-RUNTIME_initscripts = "initscripts"

# udev/eudev is required
VIRTUAL-RUNTIME_dev_manager = "udev"

# Toolchain / build behavior
SDK_NAME = "magnesium-sdk"
TCLIBC = "glibc"

# Package format (small + simple)
PACKAGE_CLASSES = "package_ipk"

# Remove unneeded/conflicting features
DISTRO_FEATURES:remove = " \
    qt \
    alsa \
    pulseaudio \
    bluetooth \
    nfc \
    3g \
    directfb \
    pam \
    x11 \
    wayland \
    opengl \
    vulkan \
    opencl \
    pam \
    polkit \
    gobject-introspection-data \
    api-documentation \
    keyboard \
"
```

## layers/meta-magnesium/conf/layer.conf
```bitbake
BBPATH .= ":${LAYERDIR}"

BBFILES += "${LAYERDIR}/recipes-*/*/*.bb \
            ${LAYERDIR}/recipes-*/*/*.bbappend"

BBFILES += "${LAYERDIR}/classes/*.bb*"

WKS_SEARCH_PATH:append = ":${LAYERDIR}/files/wic"

LAYERSERIES_COMPAT_magnesium = "wrynose"
```

## layers/meta-magnesium/conf/machine/luckfox-lyra-pi.conf
```bitbake
#@TYPE: Machine
#@NAME: Luckfox Lyra PI B+W
#@DESCRIPTION: Luckfox Lyra PI B+W RK3506B machine for magnesium-core

require conf/machine/include/arm/armv7a/tune-cortexa7.inc

MACHINEOVERRIDES =. "rk3506:"

DEFAULTTUNE ?= "cortexa7thf-neon-vfpv4"

# Kernel
PREFERRED_PROVIDER_virtual/kernel = "linux-rockchip-rk3506"
PREFERRED_VERSION_linux-rockchip-rk3506 = "6.6%"

# Boot variables
KERNEL_IMAGETYPE = "zImage"
KERNEL_DEVICETREE = "rockchip/rk3506b-luckfox-lyra-pi-sd.dtb"

# Keep this minimal for your UART + network target.
MACHINE_FEATURES = "kernel26 serial ethernet usbhost usbgadget ext2"

# Useful defaults for small embedded boards.
MACHINE_EXTRA_RRECOMMENDS += "kernel-modules"

# U-Boot Bootloader
PREFERRED_PROVIDER_virtual/bootloader = "u-boot-rockchip"
UBOOT_MACHINE = "rk3506_luckfox_defconfig"
```

## layers/meta-magnesium/conf/machine/luckfox-lyra-plus.conf
```bitbake
#@TYPE: Machine
#@NAME: Luckfox Lyra Plus
#@DESCRIPTION: Luckfox Lyra Plus RK3506G2 machine for magnesium-core

require conf/machine/include/arm/armv7a/tune-cortexa7.inc

MACHINEOVERRIDES =. "rk3506:"

DEFAULTTUNE ?= "cortexa7thf-neon-vfpv4"

# Kernel
PREFERRED_PROVIDER_virtual/kernel = "linux-rockchip-rk3506"
PREFERRED_VERSION_linux-rockchip-rk3506 = "6.6%"

KERNEL_IMAGETYPE = "zImage"

# Kernel DTB target, relative to arch/arm/boot/dts/
KERNEL_DEVICETREE = "rockchip/rk3506g-luckfox-lyra-plus-magnesium.dtb"

# Keep this minimal for your UART + network target.
MACHINE_FEATURES = "kernel26 serial ethernet usbhost usbgadget ext2"

# Set this only after confirming the actual Linux console device from the
# board/vendor boot log. Rockchip vendor kernels often use unusual console names.
#
# SERIAL_CONSOLES = "1500000;ttyFIQ0"
# SERIAL_CONSOLES = "115200;ttyS0"

# Useful defaults for small embedded boards.
MACHINE_EXTRA_RRECOMMENDS += "kernel-modules"
```
